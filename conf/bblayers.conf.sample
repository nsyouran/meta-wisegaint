## conf/bblayers.conf.sample
```bitbake
# LAYER_CONF_VERSION is increased each time build/conf/bblayers.conf
# changes incompatibly
LCONF_VERSION = "6"

BBPATH = "${TOPDIR}"
BBFILES ?= ""
BBLAYERS ?= " \
  ##COREBASE##/meta \
  ##COREBASE##/meta-yocto \
  ##COREBASE##/meta-yocto-bsp \
  ##COREBASE##/meta-openembedded/meta-gnome \
  ##COREBASE##/meta-openembedded/meta-oe \
  ##COREBASE##/meta-openembedded/meta-xfce \
  ##COREBASE##/meta-openembedded/meta-systemd \
  ##COREBASE##/meta-openembedded/meta-networking \
  ##COREBASE##/meta-openembedded/meta-multimedia \
  ##COREBASE##/meta-openembedded/meta-python \
  ##COREBASE##/meta-sunxi \
  ##COREBASE##/meta-wisegaint \
  ##COREBASE##/meta-qt5 \
  ##COREBASE##/meta-ros \
  ##COREBASE##/meta-browser \
  ##COREBASE##/meta-nodejs \
  "
```

## conf/layer.conf
```bitbake
# We have a conf directory, append to BBPATH
BBPATH .= ":${LAYERDIR}"

# We have a recipes directory, add to BBFILES
BBFILES += "${LAYERDIR}/recipes-*/*/*.bb \
            ${LAYERDIR}/recipes-*/*/*.bbappend"

BBFILE_COLLECTIONS += "meta-wisegaint"
BBFILE_PATTERN_meta-wisegaint := "^${LAYERDIR}/"
BBFILE_PRIORITY_meta-wisegaint = "8"
```
